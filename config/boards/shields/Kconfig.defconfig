## config/boards/shields/Kconfig.defconfig
```kconfig
if SHIELD_VANCE_LEFT

config ZMK_KEYBOARD_NAME
    default "Vance"

config ZMK_SPLIT_ROLE_CENTRAL
    default y

endif

if SHIELD_VANCE_LEFT || SHIELD_VANCE_RIGHT

config ZMK_SPLIT
    default y

endif
```

## config/boards/shields/vance/Kconfig.shield
```kconfig
config SHIELD_VANCE_LEFT
    def_bool $(shields_list_contains,vance_left)

config SHIELD_VANCE_RIGHT
    def_bool $(shields_list_contains,vance_right)
```
